/**
 * RT-Thread RuiChing
 *
 * COPYRIGHT (C) 2024-2025 Shanghai Real-Thread Electronic Technology Co., Ltd.
 * All rights reserved.
 *
 * The license and distribution terms for this file may be
 * found in the file LICENSE in this distribution.
 */
/dts-v1/;
#include "rc-pi-3562-v1_0.dtsi"

&i2c3 {
	status = "okay,rtt";
	pinctrl = <&gpio3_a0 &gpio3_a1>;
};

&gpio3_a0 {
	mux = <1>;
};

&gpio3_a1 {
	mux = <1>;
};
